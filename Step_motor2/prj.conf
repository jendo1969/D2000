## prj.conf
```kconfig
CONFIG_STDOUT_CONSOLE=y
CONFIG_PRINTK=y
CONFIG_GPIO=y

CONFIG_PWM=y
CONFIG_PINMUX=y
CONFIG_PWM_QMSI_NUM_PORTS=2

CONFIG_I2C=y

# ISSM_CONFIGURATION
# Enable OS Awareness
CONFIG_DEBUG_TRACING_KERNEL_OBJECTS=y
CONFIG_THREAD_MONITOR=y
CONFIG_GDB_INFO=y

# Configure platform
CONFIG_ARC_INIT=n
CONFIG_ARC_INIT_DEBUG=n
CONFIG_ARC_GDB_ENABLE=n
```

## src/main.c
```c
/*
 * Copyright (c) 2016 Intel Corporation
 *
 * SPDX-License-Identifier: Apache-2.0
 */

/**
 * @file Sample app to demonstrate PWM.
 *
 * This app uses PWM[0].
 */

#include <zephyr.h>
#include <kernel.h>

#include <misc/printk.h>
#include <device.h>
#include <pwm.h>
#include <pinmux.h>

#include <board.h>
#include <device.h>
#include <gpio.h>
#include <misc/util.h>

#include <i2c.h>

#include "INA219.h"

//#include <INA219.h>


#define MSEC_100 100
#define MSEC_50 50
#define MSEC_10 10
#define MSEC_1 1

/* change this to use another GPIO port */
#define PORT	SW0_GPIO_NAME

/* change to use another GPIO pin interrupt config */
#define EDGE    (GPIO_INT_EDGE | GPIO_INT_ACTIVE_LOW | GPIO_INT_ACTIVE_HIGH | GPIO_INT_DOUBLE_EDGE)

/* change this to enable pull-up/pull-down */
#define PULL_UP 0

#define PIN_A     10
#define PIN_B     5

#define PIN_SW    SW0_GPIO_PIN

#define PIN_DIR   9

/* change this to enable pull-up/pull-down */
#define PULL_UP 0

int count = 0;
int old_count = 0;
uint32_t val = 0;
uint32_t old_A = 0;
uint32_t old_B = 0;

uint32_t time_cnt = 0;

#define PWM_DRIVER CONFIG_PWM_QMSI_DEV_NAME
#define PWM_CHANNEL 1

#define PINMUX_NAME CONFIG_PINMUX_NAME
#define PWM1_PIN 24

/* in micro second */
//#define MIN_PERIOD	2000
//#define MIN_PERIOD	(USEC_PER_SEC / 5000) // 200us
//#define MIN_PERIOD	(USEC_PER_SEC / 800) // 1250us 60rpm
//#define MIN_PERIOD	(USEC_PER_SEC / 1600) // 625us 120rpm
//#define MIN_PERIOD	(USEC_PER_SEC / 3200) // 312.5us 240rpm
#define MIN_PERIOD	(USEC_PER_SEC / 6400) // 156.25us 480rpm

/* in micro second */
//#define MAX_PERIOD	2000000
//#define MAX_PERIOD	200000
#define MAX_PERIOD	1000000

//#define ACC_STEP	5000
#define ACC_STEP	10000




void rotA_Trig(struct device *gpiob, struct gpio_callback *cb,
		    uint32_t pins)
{
	gpio_pin_read(gpiob, PIN_A, &val);
	if(val == 1)
	{
		if(old_B == 1)
		{
			count++;
		}
		else
		{
			count--;
		}
	}
	else
	{
		if(old_B == 1)
		{
			count--;
		}
		else
		{
			count++;
		}
	}
	old_A = val;
}

void rotB_Trig(struct device *gpiob, struct gpio_callback *cb,
		    uint32_t pins)
{
	gpio_pin_read(gpiob, PIN_B, &val);
	if(val == 1)
	{
		if(old_A == 1)
		{
			count--;
		}
		else
		{
			count++;
		}
	}
	else
	{
		if(old_A == 1)
		{
			count++;
		}
		else
		{
			count--;
		}
	}
	old_B = val;
}




static struct gpio_callback gpio_cb_A;
static struct gpio_callback gpio_cb_B;


void main(void)
{
	uint32_t val = 0;
	uint32_t old_val = 0;
	uint8_t r_dir = 0;

	struct device *gpiob;
	union dev_config cfg;

	float shuntvoltage = 0;
	float busvoltage = 0;
	float current_mA = 0;
	float loadvoltage = 0;
	float power_mW = 0;

	printk("PWM demo STEP MOTER\n");

	gpiob = device_get_binding(PORT);
	if (!gpiob) {
		printk("error\n");
		return;
	}

	// RORTRY ENCODER
	gpio_pin_configure(gpiob, PIN_A, GPIO_DIR_IN | GPIO_INT |  PULL_UP | EDGE);
	gpio_init_callback(&gpio_cb_A, rotA_Trig, BIT(PIN_A));
	gpio_add_callback(gpiob, &gpio_cb_A);
	gpio_pin_enable_callback(gpiob, PIN_A);

	gpio_pin_configure(gpiob, PIN_B, GPIO_DIR_IN | GPIO_INT |  PULL_UP | EDGE);
	gpio_init_callback(&gpio_cb_B, rotB_Trig, BIT(PIN_B));
	gpio_add_callback(gpiob, &gpio_cb_B);
	gpio_pin_enable_callback(gpiob, PIN_B);

	// SW0
	gpio_pin_configure(gpiob, PIN_SW, GPIO_DIR_IN );

	// DIR
	gpio_pin_configure(gpiob, PIN_DIR, GPIO_DIR_OUT );
	gpio_pin_write(gpiob, PIN_DIR, r_dir);

	// PWM
	struct device *pwm_dev;
	int32_t period = MAX_PERIOD;
	uint8_t dir = 0;

	pwm_dev = device_get_binding(PWM_DRIVER);
	if (!pwm_dev) {
		printk("Cannot find %s!\n", PWM_DRIVER);
		return;
	}

	struct device *pinmux = device_get_binding(PINMUX_NAME);
	uint32_t function;

	if (!pinmux) {
		printk("Cannot get PINMUX\n");
		return;
	}

	if (pinmux_pin_set(pinmux, PWM1_PIN, PINMUX_FUNC_C)) {
		printk("Fail to set pin func, %u : %u\n",
			  PWM1_PIN, PINMUX_FUNC_C);
		return;
	}

	if (pinmux_pin_get(pinmux, PWM1_PIN, &function)) {
		printk("Fail to get pin func\n");
		return;
	}

	if (function != PINMUX_FUNC_C) {
		printk("Error. PINMUX get doesn't match PINMUX set\n");
		return;
	}

	// I2C
	cfg.raw = 0;
	cfg.bits.use_10_bit_addr = 0;
	cfg.bits.speed = I2C_SPEED_STANDARD;
	cfg.bits.is_master_device = 1;

	i2c_dev = device_get_binding("I2C_0");
	if (!i2c_dev) {
		printk("I2C0: Device not found.\n");
		return;
	}

	if (i2c_configure(i2c_dev, cfg.raw) != 0) {
		printk("Error on i2c_configure()\n");
		return;
	}

	// Set chip to large range config values to start
	setCalibration_32V_2A();
//	setCalibration_16V_400mA();

	while (1)
	{
		// SW2 READ
		gpio_pin_read(gpiob, PIN_SW, &val);

		// PWM SET
		if(period == MAX_PERIOD)
		{
			if (pwm_pin_set_usec(pwm_dev, PWM_CHANNEL, MAX_PERIOD, 0))
			{
				;
				//printk("pwm pin set fails\n");
				//return;
			}
		}
		else
		{
			if (pwm_pin_set_usec(pwm_dev, PWM_CHANNEL, period, period / 2))
			{
				printk("pwm pin set fails\n");
				return;
			}
		}

		if (dir)
		{
			period += ACC_STEP;

			if (period > MAX_PERIOD)
			{
				period = MAX_PERIOD;
			}
		}
		else
		{
			period -= ACC_STEP;

			if (period < MIN_PERIOD)
			{
				period = MIN_PERIOD;
			}
		}

		if((period == MAX_PERIOD) || (period == MIN_PERIOD))
		{
			if((val == 0) && (val == old_val))
			{
				if(period == MAX_PERIOD)
				{
					if(r_dir == 0)
					{
						r_dir = 1;
					}
					else
					{
						r_dir = 0;
					}
					gpio_pin_write(gpiob, PIN_DIR, r_dir);
				}

				if(dir == 0)
				{
					dir = 1;
				}
				else
				{
					dir = 0;
				}
			}
		}
		old_val = val;

		time_cnt++;
		k_sleep(MSEC_10);

		if(time_cnt%10 == 0)
		{
//			printk("Counter = %d, sp = %d\n", count, count - old_count);
			old_count = count;

			shuntvoltage = getShuntVoltage_mV();
			busvoltage = getBusVoltage_V();
			current_mA = getCurrent_mA();
			power_mW = getPower_mW();
			loadvoltage = busvoltage + (shuntvoltage / 1000);

			printk("BV=%dmV,SV=%duV,LV=%dmV,C=%dmA,P=%dmW\n",
					(int16_t)(busvoltage*1000),
					(int32_t)(shuntvoltage*1000),
					(int16_t)(loadvoltage*1000),
					(int16_t)(current_mA),
					(int16_t)(power_mW));
		}
	}
}
```

## src/INA219.h
```c
/*
 * INA219.h
 *
 *  Created on: 2018/04/10
 *      Author: root
 */

#include <i2c.h>
#include <misc/util.h>
#include <device.h>

#ifndef SRC_INA219_H_
#define SRC_INA219_H_

//I2C
#define INA219_I2C_ADDR 0x40
/*=========================================================================
    CONFIG REGISTER (R/W)
    -----------------------------------------------------------------------*/

/**************************************************************************/
/*!
    @brief  config register address
*/
/**************************************************************************/
    #define INA219_REG_CONFIG                      (0x00)
    /*---------------------------------------------------------------------*/

/**************************************************************************/
/*!
    @brief  reset bit
*/
/**************************************************************************/
    #define INA219_CONFIG_RESET                    (0x8000)  // Reset Bit

/**************************************************************************/
/*!
    @brief  mask for bus voltage range
*/
/**************************************************************************/
    #define INA219_CONFIG_BVOLTAGERANGE_MASK       (0x2000)  // Bus Voltage Range Mask

/**************************************************************************/
/*!
    @brief  bus voltage range values
*/
/**************************************************************************/
enum{
    INA219_CONFIG_BVOLTAGERANGE_16V =        (0x0000),  // 0-16V Range
    INA219_CONFIG_BVOLTAGERANGE_32V =        (0x2000),  // 0-32V Range
};

/**************************************************************************/
/*!
    @brief  mask for gain bits
*/
/**************************************************************************/
    #define INA219_CONFIG_GAIN_MASK                (0x1800)  // Gain Mask

/**************************************************************************/
/*!
    @brief  values for gain bits
*/
/**************************************************************************/
enum{
    INA219_CONFIG_GAIN_1_40MV        =       (0x0000),  // Gain 1, 40mV Range
    INA219_CONFIG_GAIN_2_80MV        =       (0x0800),  // Gain 2, 80mV Range
    INA219_CONFIG_GAIN_4_160MV       =       (0x1000),  // Gain 4, 160mV Range
    INA219_CONFIG_GAIN_8_320MV       =       (0x1800),  // Gain 8, 320mV Range
  };

  /**************************************************************************/
/*!
    @brief  mask for bus ADC resolution bits
*/
/**************************************************************************/
    #define INA219_CONFIG_BADCRES_MASK             (0x0780)  // Bus ADC Resolution Mask

/**************************************************************************/
/*!
    @brief  values for bus ADC resolution
*/
/**************************************************************************/
enum {
    INA219_CONFIG_BADCRES_9BIT       =       (0x0000),  // 9-bit bus res = 0..511
    INA219_CONFIG_BADCRES_10BIT      =       (0x0080),  // 10-bit bus res = 0..1023
    INA219_CONFIG_BADCRES_11BIT      =       (0x0100),  // 11-bit bus res = 0..2047
    INA219_CONFIG_BADCRES_12BIT       =      (0x0180),  // 12-bit bus res = 0..4097
};

/**************************************************************************/
/*!
    @brief  mask for shunt ADC resolution bits
*/
/**************************************************************************/
    #define INA219_CONFIG_SADCRES_MASK             (0x0078)  // Shunt ADC Resolution and Averaging Mask

/**************************************************************************/
/*!
    @brief  values for shunt ADC resolution
*/
/**************************************************************************/
enum {
    INA219_CONFIG_SADCRES_9BIT_1S_84US     = (0x0000),  // 1 x 9-bit shunt sample
    INA219_CONFIG_SADCRES_10BIT_1S_148US   = (0x0008),  // 1 x 10-bit shunt sample
    INA219_CONFIG_SADCRES_11BIT_1S_276US   = (0x0010),  // 1 x 11-bit shunt sample
    INA219_CONFIG_SADCRES_12BIT_1S_532US   = (0x0018),  // 1 x 12-bit shunt sample
    INA219_CONFIG_SADCRES_12BIT_2S_1060US  = (0x0048),	 // 2 x 12-bit shunt samples averaged together
    INA219_CONFIG_SADCRES_12BIT_4S_2130US  = (0x0050),  // 4 x 12-bit shunt samples averaged together
    INA219_CONFIG_SADCRES_12BIT_8S_4260US  = (0x0058),  // 8 x 12-bit shunt samples averaged together
    INA219_CONFIG_SADCRES_12BIT_16S_8510US = (0x0060),  // 16 x 12-bit shunt samples averaged together
    INA219_CONFIG_SADCRES_12BIT_32S_17MS   = (0x0068),  // 32 x 12-bit shunt samples averaged together
    INA219_CONFIG_SADCRES_12BIT_64S_34MS   = (0x0070),  // 64 x 12-bit shunt samples averaged together
    INA219_CONFIG_SADCRES_12BIT_128S_69MS =  (0x0078),  // 128 x 12-bit shunt samples averaged together
};

/**************************************************************************/
/*!
    @brief  mask for operating mode bits
*/
/**************************************************************************/
    #define INA219_CONFIG_MODE_MASK                (0x0007)  // Operating Mode Mask

/**************************************************************************/
/*!
    @brief  values for operating mode
*/
/**************************************************************************/
 enum {
    INA219_CONFIG_MODE_POWERDOWN          =  (0x0000),
    INA219_CONFIG_MODE_SVOLT_TRIGGERED    =  (0x0001),
    INA219_CONFIG_MODE_BVOLT_TRIGGERED    =  (0x0002),
    INA219_CONFIG_MODE_SANDBVOLT_TRIGGERED = (0x0003),
    INA219_CONFIG_MODE_ADCOFF             =  (0x0004),
    INA219_CONFIG_MODE_SVOLT_CONTINUOUS  =  (0x0005),
    INA219_CONFIG_MODE_BVOLT_CONTINUOUS   =  (0x0006),
    INA219_CONFIG_MODE_SANDBVOLT_CONTINUOUS = (0x0007),
};
/*=========================================================================*/
/**************************************************************************/
/*!
    @brief  shunt voltage register
*/
/**************************************************************************/
    #define INA219_REG_SHUNTVOLTAGE                (0x01)
/*=========================================================================*/

/**************************************************************************/
/*!
    @brief  bus voltage register
*/
/**************************************************************************/
    #define INA219_REG_BUSVOLTAGE                  (0x02)
/*=========================================================================*/

/**************************************************************************/
/*!
    @brief  power register
*/
/**************************************************************************/
    #define INA219_REG_POWER                       (0x03)
/*=========================================================================*/

/**************************************************************************/
/*!
    @brief  current register
*/
/**************************************************************************/
    #define INA219_REG_CURRENT                     (0x04)
/*=========================================================================*/

/**************************************************************************/
/*!
    @brief  calibration register
*/
/**************************************************************************/
    #define INA219_REG_CALIBRATION                 (0x05)
/*=========================================================================*/
//uint8_t ina219_i2caddr;
uint32_t ina219_calValue;
// The following multipliers are used to convert raw current and power
// values to mA and mW, taking into account the current config settings
uint32_t ina219_currentDivider_mA;
uint32_t ina219_powerMultiplier_mW;
struct device *i2c_dev;

void setCalibration_32V_2A(void);
void setCalibration_16V_400mA(void);
float getShuntVoltage_mV();
float getBusVoltage_V();
float getCurrent_mA();
float getPower_mW();


/**************************************************************************/
/*!
    @brief  Sends a single command byte over I2C
*/
/**************************************************************************/
void wireWriteRegister (uint8_t reg, uint16_t value)
{
	int8_t data[3];

	data[0] = reg;
	data[1] = (value >> 8);                 // Upper 8-bits
	data[2] = (value & 0xFF);               // Lower 8-bits
	i2c_write(i2c_dev, &data, sizeof(data), INA219_I2C_ADDR);

	k_sleep(10);
}

/**************************************************************************/
/*!
    @brief  Reads a 16 bit values over I2C
*/
/**************************************************************************/
void wireReadRegister(uint8_t reg, uint16_t *value)
{
	uint8_t data[2];

	i2c_write(i2c_dev, &reg, sizeof(reg), INA219_I2C_ADDR);

	k_sleep(10);

	data[0] = 0;                 // Upper 8-bits
	data[1] = 0;                 // Lower 8-bits
	i2c_read(i2c_dev, &data, sizeof(data), INA219_I2C_ADDR);
	k_sleep(10);

    // Shift values to create properly formed integer
    *value = ((data[0] << 8) | data[1]);
}

/**************************************************************************/
/*!
    @brief  Configures to INA219 to be able to measure up to 32V and 2A
            of current.  Each unit of current corresponds to 100uA, and
            each unit of power corresponds to 2mW. Counter overflow
            occurs at 3.2A.

    @note   These calculations assume a 0.1 ohm resistor is present
*/
/**************************************************************************/
void setCalibration_32V_2A(void)
{
  // By default we use a pretty huge range for the input voltage,
  // which probably isn't the most appropriate choice for system
  // that don't use a lot of power.  But all of the calculations
  // are shown below if you want to change the settings.  You will
  // also need to change any relevant register settings, such as
  // setting the VBUS_MAX to 16V instead of 32V, etc.

  // VBUS_MAX = 32V             (Assumes 32V, can also be set to 16V)
  // VSHUNT_MAX = 0.32          (Assumes Gain 8, 320mV, can also be 0.16, 0.08, 0.04)
  // RSHUNT = 0.1               (Resistor value in ohms)

  // 1. Determine max possible current
  // MaxPossible_I = VSHUNT_MAX / RSHUNT
  // MaxPossible_I = 3.2A

  // 2. Determine max expected current
  // MaxExpected_I = 2.0A

  // 3. Calculate possible range of LSBs (Min = 15-bit, Max = 12-bit)
  // MinimumLSB = MaxExpected_I/32767
  // MinimumLSB = 0.000061              (61uA per bit)
  // MaximumLSB = MaxExpected_I/4096
  // MaximumLSB = 0,000488              (488uA per bit)

  // 4. Choose an LSB between the min and max values
  //    (Preferrably a roundish number close to MinLSB)
  // CurrentLSB = 0.0001 (100uA per bit)

  // 5. Compute the calibration register
  // Cal = trunc (0.04096 / (Current_LSB * RSHUNT))
  // Cal = 4096 (0x1000)

  ina219_calValue = 4096;

  // 6. Calculate the power LSB
  // PowerLSB = 20 * CurrentLSB
  // PowerLSB = 0.002 (2mW per bit)

  // 7. Compute the maximum current and shunt voltage values before overflow
  //
  // Max_Current = Current_LSB * 32767
  // Max_Current = 3.2767A before overflow
  //
  // If Max_Current > Max_Possible_I then
  //    Max_Current_Before_Overflow = MaxPossible_I
  // Else
  //    Max_Current_Before_Overflow = Max_Current
  // End If
  //
  // Max_ShuntVoltage = Max_Current_Before_Overflow * RSHUNT
  // Max_ShuntVoltage = 0.32V
  //
  // If Max_ShuntVoltage >= VSHUNT_MAX
  //    Max_ShuntVoltage_Before_Overflow = VSHUNT_MAX
  // Else
  //    Max_ShuntVoltage_Before_Overflow = Max_ShuntVoltage
  // End If

  // 8. Compute the Maximum Power
  // MaximumPower = Max_Current_Before_Overflow * VBUS_MAX
  // MaximumPower = 3.2 * 32V
  // MaximumPower = 102.4W

  // Set multipliers to convert raw current/power values
  ina219_currentDivider_mA = 10;  // Current LSB = 100uA per bit (1000/100 = 10)
  ina219_powerMultiplier_mW = 2;     // Power LSB = 1mW per bit (2/1)

  // Set Calibration register to 'Cal' calculated above
  wireWriteRegister(INA219_REG_CALIBRATION, ina219_calValue);

  // Set Config register to take into account the settings above
  uint16_t config = INA219_CONFIG_BVOLTAGERANGE_32V |
                    INA219_CONFIG_GAIN_8_320MV |
                    INA219_CONFIG_BADCRES_12BIT |
                    INA219_CONFIG_SADCRES_12BIT_1S_532US |
                    INA219_CONFIG_MODE_SANDBVOLT_CONTINUOUS;
  wireWriteRegister(INA219_REG_CONFIG, config);
}

/**************************************************************************/
/*!
    @brief set device to alibration which uses the highest precision for
      current measurement (0.1mA), at the expense of
      only supporting 16V at 400mA max.
*/
/**************************************************************************/
void setCalibration_16V_400mA(void) {

  // Calibration which uses the highest precision for
  // current measurement (0.1mA), at the expense of
  // only supporting 16V at 400mA max.

  // VBUS_MAX = 16V
  // VSHUNT_MAX = 0.04          (Assumes Gain 1, 40mV)
  // RSHUNT = 0.1               (Resistor value in ohms)

  // 1. Determine max possible current
  // MaxPossible_I = VSHUNT_MAX / RSHUNT
  // MaxPossible_I = 0.4A

  // 2. Determine max expected current
  // MaxExpected_I = 0.4A

  // 3. Calculate possible range of LSBs (Min = 15-bit, Max = 12-bit)
  // MinimumLSB = MaxExpected_I/32767
  // MinimumLSB = 0.0000122              (12uA per bit)
  // MaximumLSB = MaxExpected_I/4096
  // MaximumLSB = 0.0000977              (98uA per bit)

  // 4. Choose an LSB between the min and max values
  //    (Preferrably a roundish number close to MinLSB)
  // CurrentLSB = 0.00005 (50uA per bit)

  // 5. Compute the calibration register
  // Cal = trunc (0.04096 / (Current_LSB * RSHUNT))
  // Cal = 8192 (0x2000)

  ina219_calValue = 8192;

  // 6. Calculate the power LSB
  // PowerLSB = 20 * CurrentLSB
  // PowerLSB = 0.001 (1mW per bit)

  // 7. Compute the maximum current and shunt voltage values before overflow
  //
  // Max_Current = Current_LSB * 32767
  // Max_Current = 1.63835A before overflow
  //
  // If Max_Current > Max_Possible_I then
  //    Max_Current_Before_Overflow = MaxPossible_I
  // Else
  //    Max_Current_Before_Overflow = Max_Current
  // End If
  //
  // Max_Current_Before_Overflow = MaxPossible_I
  // Max_Current_Before_Overflow = 0.4
  //
  // Max_ShuntVoltage = Max_Current_Before_Overflow * RSHUNT
  // Max_ShuntVoltage = 0.04V
  //
  // If Max_ShuntVoltage >= VSHUNT_MAX
  //    Max_ShuntVoltage_Before_Overflow = VSHUNT_MAX
  // Else
  //    Max_ShuntVoltage_Before_Overflow = Max_ShuntVoltage
  // End If
  //
  // Max_ShuntVoltage_Before_Overflow = VSHUNT_MAX
  // Max_ShuntVoltage_Before_Overflow = 0.04V

  // 8. Compute the Maximum Power
  // MaximumPower = Max_Current_Before_Overflow * VBUS_MAX
  // MaximumPower = 0.4 * 16V
  // MaximumPower = 6.4W

  // Set multipliers to convert raw current/power values
  ina219_currentDivider_mA = 20;  // Current LSB = 50uA per bit (1000/50 = 20)
  ina219_powerMultiplier_mW = 1;     // Power LSB = 1mW per bit

  // Set Calibration register to 'Cal' calculated above
  wireWriteRegister(INA219_REG_CALIBRATION, ina219_calValue);

  // Set Config register to take into account the settings above
  uint16_t config = INA219_CONFIG_BVOLTAGERANGE_16V |
                    INA219_CONFIG_GAIN_1_40MV |
                    INA219_CONFIG_BADCRES_12BIT |
                    INA219_CONFIG_SADCRES_12BIT_1S_532US |
                    INA219_CONFIG_MODE_SANDBVOLT_CONTINUOUS;
  wireWriteRegister(INA219_REG_CONFIG, config);
}
/**************************************************************************/
/*!
    @brief  Gets the raw bus voltage (16-bit signed integer, so +-32767)
    @return the raw bus voltage reading
*/
/**************************************************************************/
int16_t getBusVoltage_raw() {
  uint16_t value;
  wireReadRegister(INA219_REG_BUSVOLTAGE, &value);

  // Shift to the right 3 to drop CNVR and OVF and multiply by LSB
  return (int16_t)((value >> 3) * 4);
}

/**************************************************************************/
/*!
    @brief  Gets the raw shunt voltage (16-bit signed integer, so +-32767)
    @return the raw shunt voltage reading
*/
/**************************************************************************/
int16_t getShuntVoltage_raw() {
  uint16_t value;
  wireReadRegister(INA219_REG_SHUNTVOLTAGE, &value);
  return (int16_t)value;
}

/**************************************************************************/
/*!
    @brief  Gets the raw current value (16-bit signed integer, so +-32767)
    @return the raw current reading
*/
/**************************************************************************/
int16_t getCurrent_raw() {
  uint16_t value;

  // Sometimes a sharp load will reset the INA219, which will
  // reset the cal register, meaning CURRENT and POWER will
  // not be available ... avoid this by always setting a cal
  // value even if it's an unfortunate extra step
  wireWriteRegister(INA219_REG_CALIBRATION, ina219_calValue);

  // Now we can safely read the CURRENT register!
  wireReadRegister(INA219_REG_CURRENT, &value);

  return (int16_t)value;
}

/**************************************************************************/
/*!
    @brief  Gets the raw power value (16-bit signed integer, so +-32767)
    @return raw power reading
*/
/**************************************************************************/
int16_t getPower_raw() {
  uint16_t value;

  // Sometimes a sharp load will reset the INA219, which will
  // reset the cal register, meaning CURRENT and POWER will
  // not be available ... avoid this by always setting a cal
  // value even if it's an unfortunate extra step
  wireWriteRegister(INA219_REG_CALIBRATION, ina219_calValue);

  // Now we can safely read the POWER register!
  wireReadRegister(INA219_REG_POWER, &value);

  return (int16_t)value;
}

/**************************************************************************/
/*!
    @brief  Gets the shunt voltage in mV (so +-327mV)
    @return the shunt voltage converted to millivolts
*/
/**************************************************************************/
float getShuntVoltage_mV() {
  int16_t value;
  value = getShuntVoltage_raw();
  return value * 0.01;
}

/**************************************************************************/
/*!
    @brief  Gets the shunt voltage in volts
    @return the bus voltage converted to volts
*/
/**************************************************************************/
float getBusVoltage_V() {
  int16_t value = getBusVoltage_raw();
  return value * 0.001;
}

/**************************************************************************/
/*!
    @brief  Gets the current value in mA, taking into account the
            config settings and current LSB
    @return the current reading convereted to milliamps
*/
/**************************************************************************/
float getCurrent_mA() {
  float valueDec = getCurrent_raw();
  valueDec /= ina219_currentDivider_mA;
  return valueDec;
}

/**************************************************************************/
/*!
    @brief  Gets the power value in mW, taking into account the
            config settings and current LSB
    @return power reading converted to milliwatts
*/
/**************************************************************************/
float getPower_mW() {
  float valueDec = getPower_raw();
  valueDec *= ina219_powerMultiplier_mW;
  return valueDec;
}


#endif /* SRC_INA219_H_ */
```
