## prj.conf
```kconfig
CONFIG_WATCHDOG=y


# ISSM_CONFIGURATION
# Enable OS Awareness
CONFIG_DEBUG_TRACING_KERNEL_OBJECTS=y
CONFIG_THREAD_MONITOR=y
CONFIG_GDB_INFO=y

CONFIG_SERIAL=y
CONFIG_UART_INTERRUPT_DRIVEN=n
CONFIG_UART_QMSI_0=y
CONFIG_UART_QMSI_0_HW_FC=n
CONFIG_UART_QMSI_0_BAUDRATE=57600

#CONFIG_UART_QMSI_1=y
#CONFIG_UART_QMSI_1_HW_FC=n
#CONFIG_UART_QMSI_1_BAUDRATE=57600

# Configure platform
CONFIG_ARC_INIT=n
CONFIG_ARC_INIT_DEBUG=n
CONFIG_ARC_GDB_ENABLE=n
```

## src/main.c
```c
/*
 * Copyright (c) 2015 Intel Corporation
 *
 * SPDX-License-Identifier: Apache-2.0
 */

#include <zephyr.h>

#include <device.h>
#include <uart.h>
#include "board.h"
#include <misc/printk.h>

/* 1000 msec = 1 sec */
#define SLEEP_TIME 	1000

void main(void)
{
	struct device *uart_dev;

	uart_dev = device_get_binding("UART_0");

	while(1)
	{
		uart_poll_out(uart_dev, 'a');

		k_sleep(SLEEP_TIME);
	}
}
```
