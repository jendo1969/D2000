## UARTint/zephyr/ext/hal/Kconfig
```kconfig
# Kconfig - external HAL source code configuration options

#
# Copyright (c) 2016 Linaro Ltd.
#
# SPDX-License-Identifier: Apache-2.0
#

# When adding new entries keep the list in alphabetical order

menu "HALs"

source "ext/hal/qmsi/Kconfig"

endmenu
```
